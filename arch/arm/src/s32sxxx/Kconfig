## arch/arm/src/s32sxxx/Kconfig
```kconfig
#
# For a description of the syntax of this configuration file,
# see the file kconfig-language.txt in the NuttX tools repository.
#

if ARCH_CHIP_S32SXXX

# Chip Selection

choice
	prompt "S32SXXX Chip Selection"
	default ARCH_CHIP_S32X247TV

config ARCH_CHIP_S32S247TV
	bool "S32S247TV"
	select ARCH_CHIP_S32S2
	select S32SXXX_HAVE_ENET
	---help---
		Cortex-R52, 4 core complex, XXKb FLASH, XXKb RAM

endchoice # S32SXXX Chip Selection

# Chip Family

config ARCH_CHIP_S32S2
	bool
	select ARCH_CORTEXR52

# Chip Capabilities

config S32SXXX_ENET
	bool "Ethernet"
	default n
	depends on S32SXXX_HAVE_ENET

endif # ARCH_CHIP_S32SXXX
```
